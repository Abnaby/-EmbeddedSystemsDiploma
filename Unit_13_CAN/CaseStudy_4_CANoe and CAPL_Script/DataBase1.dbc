VERSION ""

NS_ :

BS_:

BU_: ECU2_SpeedControl ECU1_PadelControl

BO_ 939 Speed_Value: 1 ECU2_SpeedControl
 SG_ SPD_Signal : 0|8@1+ (1,0) [0|255] ""  ECU1_PadelControl

BO_ 48 Acceleration_CMD: 1 ECU1_PadelControl
 SG_ ACC_Signal : 0|8@1+ (1,0) [0|1] ""  ECU2_SpeedControl
